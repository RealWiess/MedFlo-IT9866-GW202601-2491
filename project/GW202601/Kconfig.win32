## project/GW202601/Kconfig.win32
```kconfig
#
# For a description of the syntax of this configuration file,
# see Documentation/kbuild/kconfig-language.txt.
#

mainmenu "Project Configuration"

config AUTOMOTIVE_DISPLAY
    bool
    default y
    select HAVE_LCD
    select HAVE_GRAPHICS
    select HAVE_AUDIO

config CMAKE_SOURCE_DIR
	string
	option env="CMAKE_SOURCE_DIR"

config RAM_SIZE
    default "0x4000000"

config RAM_INIT_SCRIPT
    default "IT9860_396Mhz_DDR2_396Mhz.scr"

config WATCHDOG_ENABLE
    def_bool y

config FONT_FILENAME
    default "Roboto-Regular.ttf"

config BACKLIGHT_ENABLE
    def_bool y

config BACKLIGHT_DUTY_CYCLES
    default "5, 25, 40, 55, 65, 75, 82, 88, 92, 95"

config BACKLIGHT_DEFAULT_DUTY_CYCLE
    default "95"

config ENABLE_ROTATE
    def_bool y

config LCD_ENABLE
    def_bool y

if !LCD_MULTIPLE

config LCD_WIDTH
    default "1200"

config LCD_HEIGHT
    default "1920"

config LCD_PITCH
    default "2560"

config LCD_INIT_SCRIPT
    default "LVDS_1280_480_VESA24bits_new.txt"

endif

config CMDQ_ENABLE
    def_bool y

config AUDIO_ENABLE
    def_bool y
    
config SD0_ENABLE
    def_bool y

config FS_FAT
    def_bool y

config I2C0_ENABLE
    def_bool y

config I2S_ENABLE
    def_bool y

config I2S_SPDIF_ENABLE
    def_bool n

config UART1_ENABLE
    def_bool y

config TOUCH_ENABLE
    def_bool y

config NET_ENABLE
    def_bool n

config DEF_DBG_UART1
    def_bool y

config DEF_BUILD_DEBUG
    def_bool y

config SYSTEM_NAME
    default "ITE Display Control Board"

config WIN32_SIMULATOR
    def_bool y

config FFMPEG_ENC
    def_bool y

config FFMPEG_H264_SW
    def_bool y

config ITU_FT_CACHE_ENABLE
    def_bool y

config ITU_UCL_ENABLE
    def_bool y

config BUILD_AUDIO_MGR
    def_bool y

config BUILD_INIPARSER
    def_bool y

config BUILD_ITU
    def_bool y

config BUILD_SDL
    def_bool y

config BUILD_UPGRADE
    def_bool y

config BUILD_PYINPUT
    def_bool y
    
config BUILD_QRENCODE
    def_bool y

config BUILD_JPEG
    def_bool y    
    
#config BUILD_LEAF
#    def_bool y
    
#config BUILD_LINPHONE
#    def_bool y

if NET_ENABLE

config NET_ETHERNET
    def_bool y

config NET_HTTP
    def_bool y

config BUILD_MICROHTTPD
    def_bool y

config BUILD_XML2
    def_bool y

endif

source "$CMAKE_SOURCE_DIR/sdk/Kconfig"

######################################################################
# Project Menu
######################################################################
menu "Display Control Board"

    config CHECK_FILES_CRC_ON_BOOTING
        bool "Checking files' CRC on booting time"
        default n
        help
            Checking files' CRC on booting time
        help_cht
            開啟開機時檢查檔案 CRC 值的功能。
        help_chs
            开启开机时检查档案 CRC 值的功能。

    config HW_VERSION
        string "Hardware version"
        default "V2"
        help
            Hardware version
        help_cht
            硬體版號。
        help_chs
            硬件版号。

    config HW_TEST
        bool "Enable hardware test"
        default n
        help
            Enable hardware test
        help_cht
            開啟硬體測試功能。
        help_chs
            开启硬体测试功能。
    config PLAY_DEMO_VIDEO
        bool "Play demo video"
        default n
        help
            Play demo video
        help_cht
            播放示範影片。
        help_chs
            播放示范影片。

    config DEMO_MODE
        bool "Enable Demo mode"
        default n
        help
            Enable  demo function mode
        help_cht
            展示模式開關。
        help_chs
            展示模式开关。

    config SCREENSHOT_ENABLE
        bool "Screenshot is enabled or not"
        default n
        help
            Screenshot is enabled or not
        help_cht
            開啟螢幕擷取功能。
        help_chs
            开启屏幕撷取功能。

    config WEBSERVER_PORT
        string "Web server port"
        default "80"
        help
            Web server port
        help_cht
            網頁伺服器埠號。
        help_chs
            网页服务器埠号。

    config ITU_PATH
        string "ITU files path"
        depends on !LCD_MULTIPLE
        default "itu/1280x480Demo"
        help
            ITU files path
        help_cht
            ITU檔案路徑。
        help_chs
            ITU档案路径。

    config UPGRADE_FTP_URL
        string "Upgrade ftp URL"
        default "ftp://192.168.1.1/ctrlboard/ITEPKG03.PKG"
        help
            Upgrade ftp URL
        help_cht
            網路更新F/W路徑。
        help_chs
            网络更新F/W路径。

    config UPGRADE_GUI
        bool "Upgrade by graphics display"
        depends on !LCD_MULTIPLE
        default n
        help
            Upgrade by graphics display
        help_cht
            圖形顯示更新。
        help_chs
            图形显示更新。

    config AUTO_RUN
        bool "Auto Run Enable"
        default n
        help
            Auto Demo.
        help_cht
            自動展示模式。
        help_chs
            自动展示模式。

    config AUTO_CHANGE_TYPE
        bool "Auto Type Enable"
        default n
        help
            Auto Demo with Change Type.
        help_cht
            自動展示切換儀表。
        help_chs
            自动展示切换仪表。 

    config MIRROR_TEST
        bool "Mirror Test"
        default n
        help
            Mirror Test. 
        help_cht
            手機投屏測試
        help_chs
            手机投屏测试           
endmenu
```

## project/GW202601_LVGL_v2/Kconfig
```kconfig
#
# GW202601_LVGL_v2 — Kconfig (adapted from lv_demos for 480x480 Gateway LCD)
#

mainmenu "Project Configuration"

config LV_DEMOS
    bool
    default y
    select HAVE_LCD
    select HAVE_GRAPHICS

config CMAKE_SOURCE_DIR
    string
    option env="CMAKE_SOURCE_DIR"

config BACKLIGHT_ENABLE
    def_bool y

config LCD_ENABLE
    def_bool y

# Gateway LCD is 480x480, no rotation needed
# config ENABLE_ROTATE is not set

config LCD_WIDTH
    default "480"

config LCD_HEIGHT
    default "480"

config LCD_PITCH
    default "960"

config LCD_INIT_SCRIPT
    default "IT9860_AVM040EXA02J-X01_RGB565_18bits_Gateway.txt"

config LCD_TRIPLE_BUFFER
    default y

config BACKLIGHT_DUTY_CYCLES
    default "20, 40, 60, 80, 100, 0, 0, 0, 0, 0"

config BACKLIGHT_DEFAULT_DUTY_CYCLE
    default "40"

config CMDQ_ENABLE
    def_bool y

# config SPI_ENABLE is not set

config I2C1_ENABLE
    def_bool y

config GPIO_IIC1_CLK
    default "27"

config GPIO_IIC1_DATA
    default "28"

# config TOUCH_ENABLE is not set

config GPIO_LCD_PWR_EN
    default "67"

config GPIO_BACKLIGHT_PWM
    default "33"

config DBG_INIT_SCRIPT
    default "IT9860_792Mhz_DDR3_792Mhz.txt"

# config TSLIB_STATIC_CONF is not set

config BUILD_IT2D
    def_bool y

config BUILD_LVGL
    def_bool y

config BUILD_FREETYPE
    def_bool y

config BUILD_ZLIB
    def_bool y

source "$CMAKE_SOURCE_DIR/sdk/Kconfig"
```

## project/lv_demos/Kconfig
```kconfig
#
# For a description of the syntax of this configuration file,
# see Documentation/kbuild/kconfig-language.txt.
#

mainmenu "Project Configuration"

config LV_DEMOS
    bool
    default y
    select HAVE_LCD
    select HAVE_GRAPHICS

config CMAKE_SOURCE_DIR
    string
    option env="CMAKE_SOURCE_DIR"

config BACKLIGHT_ENABLE
    def_bool y

config LCD_ENABLE
    def_bool y

config ENABLE_ROTATE
    def_bool y

config LCD_WIDTH
    default "1280"

config LCD_HEIGHT
    default "480"

config LCD_PITCH
    default "2560"

config LCD_INIT_SCRIPT
    default "IT9860_MIPI_TL068HWXH08_EK79030_480x1280_4LANE_byteclk53.txt"

config LCD_TRIPLE_BUFFER
    default n

config BACKLIGHT_ENABLE
    def_bool y

config BACKLIGHT_DUTY_CYCLES
    default "5, 25, 40, 55, 65, 75, 82, 88, 92, 95"

config BACKLIGHT_DEFAULT_DUTY_CYCLE
    default "95"

config CMDQ_ENABLE
    def_bool y

config SPI_ENABLE
    def_bool n

config I2C1_ENABLE
    def_bool y

config GPIO_IIC1_CLK
    default "62"

config GPIO_IIC1_DATA
    default "61"

config TOUCH_ENABLE
    def_bool y

config TOUCH_MODULE
    default "gt911"

config TOUCH_X_MAX_VALUE
    default "0x4FF"

config TOUCH_Y_MAX_VALUE
    default "0x1DF"

config TOUCH_ADVANCE_CONFIG
	def_bool y

config TOUCH_SWAP_XY
	def_bool y

config GPIO_TOUCH_INT
    default "60"

config GPIO_TOUCH_RESET
    default "59"

config GPIO_TOUCH_WAKE
    default "-1"

config DEF_TOUCH_I2C1
    def_bool y

config TOUCH_INTR
    def_bool y

config GPIO_UART0_TX
    default "4"

config GPIO_UART0_RX
    default "-1"

config GPIO_LCD_PWR_EN
    default "-1"

config GPIO_BACKLIGHT_PWM
    default "63"

config DBG_INIT_SCRIPT
    default "IT9860_396Mhz_DDR2_396Mhz.txt"

config TSLIB_STATIC_CONF
    def_bool y

config BUILD_IT2D
    def_bool y

config BUILD_LVGL
    def_bool y

config BUILD_FREETYPE
    def_bool y

config BUILD_ZLIB
    def_bool y

source "$CMAKE_SOURCE_DIR/sdk/Kconfig"

menu "LVGL Demos"

choice
    prompt "Demo App"
    default DEMO_BENCHMARK

config DEMO_WIDGETS
    bool "DEMO_WIDGETS"

config DEMO_BENCHMARK
    bool "DEMO_BENCHMARK"

config DEMO_STRESS
    bool "DEMO_STRESS"

config DEMO_KEYPAD_AND_ENCODER
    bool "DEMO_KEYPAD_AND_ENCODER"

config DEMO_MUSIC
    bool "DEMO_MUSIC"

config DEMO_RENDER
    bool "DEMO_RENDER"

config DEMO_VECTOR_GRAPHIC
    bool "DEMO_VECTOR_GRAPHIC"

endchoice

endmenu
```

## project/lv_demos/Kconfig.win32
```kconfig
#
# For a description of the syntax of this configuration file,
# see Documentation/kbuild/kconfig-language.txt.
#

mainmenu "Project Configuration"

config LV_DEMOS
    bool
    default y
    select HAVE_LCD
    select HAVE_GRAPHICS

config CMAKE_SOURCE_DIR
	string
	option env="CMAKE_SOURCE_DIR"

config LCD_ENABLE
    def_bool y

config LCD_WIDTH
    default "1280"

config LCD_HEIGHT
    default "480"

config LCD_PITCH
    default "2560"

config LCD_INIT_SCRIPT
    default "LVDS_1280_480_VESA24bits_new.txt"
    
config I2S_ENABLE
    def_bool y

config I2S_SPDIF_ENABLE
    def_bool n

config FFMPEG_H264_SW
    def_bool y

config BUILD_LVGL
    def_bool y

config BUILD_FREETYPE
    def_bool y

config BUILD_ZLIB
    def_bool y

config WIN32_SIMULATOR
    def_bool y

source "$CMAKE_SOURCE_DIR/sdk/Kconfig"

menu "LVGL Demos"

choice
    prompt "Demo App"
    default DEMO_BENCHMARK

config DEMO_WIDGETS
    bool "DEMO_WIDGETS"

config DEMO_BENCHMARK
    bool "DEMO_BENCHMARK"

config DEMO_STRESS
    bool "DEMO_STRESS"

config DEMO_KEYPAD_AND_ENCODER
    bool "DEMO_KEYPAD_AND_ENCODER"

config DEMO_MUSIC
    bool "DEMO_MUSIC"

config DEMO_RENDER
    bool "DEMO_RENDER"

config DEMO_VECTOR_GRAPHIC
    bool "DEMO_VECTOR_GRAPHIC"

endchoice

endmenu
```

## sdk/itu/share/itu/Kconfig
```kconfig
#
# For a description of the syntax of this configuration file,
# see Documentation/kbuild/kconfig-language.txt.
#

if BUILD_ITU

menu "itu"

config ITU_ERR
    bool "Error Log"
    default y
    help
        Output error log.
    help_cht
        輸出錯誤訊息。
    help_chs
        输出错误讯息。

config ITU_WARN
    bool "Warning Log"
    default y
    help
        Output warning log.
    help_cht
        輸出警告訊息。
    help_chs
        输出警告讯息。

config ITU_INFO
    bool "Information Log"
    default y
    help
        Output information log.
    help_cht
        輸出資訊訊息。
    help_chs
        输出资讯讯息。

config ITU_DBG
    bool "Debug Log"
    default n
    help
        Output debug log.
    help_cht
        輸出除錯訊息。
    help_chs
        输出侦错讯息。

config ITU_LOAD
    bool "Load Log"
    default n
    help
        Output load log.
    help_cht
        輸出讀取訊息。
    help_chs
        输出读取讯息。

config ITU_UPDATE
    bool "Update Log"
    default n
    help
        Output update log.
    help_cht
        輸出更新訊息。
    help_chs
        输出更新讯息。

config ITU_DRAW
    bool "Draw Log"
    default n
    help
        Output draw log.
    help_cht
        輸出繪圖訊息。
    help_chs
        输出绘图讯息。

config ITU_FT_CACHE_ENABLE
    bool "FreeType cache enable"
    default n
    help
        FreeType cache enable or not.
    help_cht
        開啟 FreeType 快取功能。
    help_chs
        开启 FreeType 快取功能。

config ITU_FT_CACHE_SIZE
    string "FreeType cache size"
    depends on ITU_FT_CACHE_ENABLE
    default "0x7D000"
    help
        FreeType cache size.
    help_cht
        設定 FreeType 快取大小。
    help_chs
        设定 FreeType 快取大小。

#config ITU_LITE_MODE
#    bool "ITU Lite mode enable"
#    default n
#    help
#        ITU Lite mode enable or not.
#    help_cht
#        開啟 ITU 架構縮減功能。
#    help_chs
#        开启 ITU 架构缩减功能。

config ITU_UCL_ENABLE
    bool "Use software decompress"
    default n
    help
        Use software decompress or not.
    help_cht
        使用軟體解壓縮功能。
    help_chs
        使用软件解压缩功能。

config ITU_ASSERT_THREAD
    bool "Assert thread"
    default n
    help
        Assert call APIs on the same thread.
    help_cht
        開啟呼叫APIs時是否在同一執行緒的功能。
    help_chs
        开启呼叫的API时是否在同一执行绪的功能。

config ITU_DECOMPRESS_SURFACE_INPLACE
    bool "Decompress surface in place"
    default n
    help
        Decompress surface in place to save memory.
    help_cht
        即時解壓縮圖片用以節省記憶體使用。
    help_chs
        即时解压缩图片用以节省內存使用。

config ITU_FONT_SURFACE_CACHE
    bool "Font surface cache pool"
    default n
    help
        Font use surface pool as cache to draw quickly.
    help_cht
        開啟固定圖檔暫存來預存文字供重覆顯示使用。
    help_chs
        开启固定图档暂存来预存文字供重覆显示使用。

config ITU_ARABICCONVERTER_SUPPORT
    bool "Arabic Text Converter support"
    default n
    help
        Text support Arabic usage.
    help_cht
        阿拉伯文支援使用。
    help_chs
        阿拉伯文支持使用。

config ITU_HARFBUZZ_SUPPORT
    bool "Harfbuzz shaping support"
    depends on CHIP_FAMILY_IT9860 || CHIP_FAMILY_IT9830 && !CHIP_PKG_IT9832 && !CHIP_PKG_IT9833
    default n
    help
        Text support Harfbuzz shaping usage.
    help_cht
        HARFBUZZ支援使用。
    help_chs
        HARFBUZZ支持使用。

config ITU_NGPL
    bool "non-GPL version"
    default n
    help
        non-GPL version.
    help_cht
        non-GPL 版本。
    help_chs
        non-GPL 版本。

endmenu

config BUILD_FFMPEG
    def_bool y if (BUILD_ITU && VIDEO_ENABLE && !ITU_NGPL)

config BUILD_FREETYPE
    def_bool y if BUILD_ITU

config BUILD_HARFBUZZ
    def_bool y if (BUILD_ITU && ITU_HARFBUZZ_SUPPORT)

config BUILD_ITC
    def_bool y if BUILD_ITU

config BUILD_ITU_RENDERER
    def_bool y if BUILD_ITU

config BUILD_JPEG
    def_bool y if (BUILD_ITU && !JPEG_HW_ENABLE)

config BUILD_PNG
    def_bool y if BUILD_ITU

config BUILD_REDBLACK
    def_bool y if BUILD_ITU

config BUILD_UCL
    def_bool y if (BUILD_ITU && ITU_UCL_ENABLE)

config BUILD_SPEEDY
    def_bool y if (BUILD_ITU && ITU_UCL_ENABLE)

config BUILD_ZLIB
    def_bool y if BUILD_ITU

endif # BUILD_ITU
```

## sdk/share/Kconfig
```kconfig
#
# For a description of the syntax of this configuration file,
# see Documentation/kbuild/kconfig-language.txt.
#

source "$CMAKE_SOURCE_DIR/sdk/share/cli/Kconfig"
source "$CMAKE_SOURCE_DIR/sdk/share/dhcps/Kconfig"

source "$CMAKE_SOURCE_DIR/sdk/share/ffmpeg/Kconfig"
source "$CMAKE_SOURCE_DIR/sdk/share/freetype/Kconfig"
source "$CMAKE_SOURCE_DIR/sdk/share/itc/Kconfig"


source "$CMAKE_SOURCE_DIR/sdk/share/sdl/Kconfig"
source "$CMAKE_SOURCE_DIR/sdk/share/sdl_image/Kconfig"
source "$CMAKE_SOURCE_DIR/sdk/share/sdl_ttf/Kconfig"
source "$CMAKE_SOURCE_DIR/sdk/share/stl/Kconfig"
source "$CMAKE_SOURCE_DIR/sdk/share/tslib/Kconfig"
source "$CMAKE_SOURCE_DIR/sdk/share/upgrade/Kconfig"
source "$CMAKE_SOURCE_DIR/sdk/share/xml2/Kconfig"
```

## sdk/share/freetype/Kconfig
```kconfig
#
# For a description of the syntax of this configuration file,
# see Documentation/kbuild/kconfig-language.txt.
#

if BUILD_FREETYPE

config BUILD_BROTLI
    def_bool y

endif # BUILD_FREETYPE
```

## sdk/share/stl/Kconfig
```kconfig
#
# For a description of the syntax of this configuration file,
# see Documentation/kbuild/kconfig-language.txt.
#

menu "stl"

config BUILD_STL
    bool "Enable IEC-60730 Class B Test"
    default n
    help
        Enable IEC-60730 Class B Tes.
    help_cht
        啟用 IEC-60730 Class B 測試。
    help_chs
        开启 IEC-60730 Class B 测试。

endmenu
```
